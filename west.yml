## west.yml
```yaml
manifest:
  defaults:
    remote: upstream

  remotes:
    - name: upstream
      url-base: https://github.com/zephyrproject-rtos

  projects:
    - name: zephyr
      remote: upstream
      revision: main
      clone-depth: 1
      import:
        name-allowlist:
          - hal_espressif
          - mbedtls
          - mcuboot

  self:
    path: .
```
